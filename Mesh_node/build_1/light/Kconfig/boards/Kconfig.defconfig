## Mesh_node/build_1/light/Kconfig/boards/Kconfig.defconfig
```kconfig
# Load Zephyr board defconfig descriptions.
osource "C:/ncs/v3.2.1/zephyr/boards/nordic/nrf54lm20dk/Kconfig.defconfig"
```

## light/build_1/Kconfig/boards/Kconfig.sysbuild
```kconfig
# Load Sysbuild board Kconfig descriptions.
osource "C:/ncs/v3.2.1/zephyr/boards/nordic/nrf54lm20dk/Kconfig.sysbuild"
```
