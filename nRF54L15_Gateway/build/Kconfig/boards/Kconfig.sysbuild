## nRF54L15_Gateway/build/Kconfig/boards/Kconfig.sysbuild
```kconfig
# Load Sysbuild board Kconfig descriptions.
osource "C:/ncs/v3.2.4/zephyr/boards/nordic/nrf54l15dk/Kconfig.sysbuild"
```

## nRF54L15_Gateway/build/UART-Gateaway/Kconfig/boards/Kconfig.defconfig
```kconfig
# Load Zephyr board defconfig descriptions.
osource "C:/ncs/v3.2.4/zephyr/boards/nordic/nrf54l15dk/Kconfig.defconfig"
```
